&mdss_mdp {
	dsi_cv1_tovis_td4100_hd_vid: qcom,mdss_dsi_cv1_tovis_td4100_hd_video{
		compatible = "qcom,mdss-dsi-panel";
		status = "disable";
		qcom,cont-splash-enabled;
		qcom,mdss-dsi-panel-name = "CV1 TOVIS TD4100 HD video mode dsi panel";
		qcom,mdss-dsi-panel-controller = <&mdss_dsi0>;
		qcom,mdss-dsi-panel-type = "dsi_video_mode";
		qcom,mdss-dsi-panel-destination = "display_1";
		qcom,mdss-dsi-panel-framerate = <60>;
		//qcom,mdss-dsi-force-clock-lane-hs;
		qcom,mdss-dsi-virtual-channel-id = <0>;
		qcom,mdss-dsi-stream = <0>;
		qcom,mdss-dsi-lp11-init;
		qcom,suspend-ulps-enabled;
		qcom,mdss-dsi-panel-width = <720>;
		qcom,mdss-dsi-panel-height = <1280>;
		qcom,mdss-dsi-h-front-porch = <84>;
		qcom,mdss-dsi-h-back-porch = <44>;
		qcom,mdss-dsi-h-pulse-width = <4>;
		qcom,mdss-dsi-h-sync-skew = <0>;
		qcom,mdss-dsi-v-front-porch = <127>;
		qcom,mdss-dsi-v-back-porch = <127>;
		qcom,mdss-dsi-v-pulse-width = <127>;
		qcom,mdss-dsi-h-left-border = <0>;
		qcom,mdss-dsi-h-right-border = <0>;
		qcom,mdss-dsi-v-top-border = <0>;
		qcom,mdss-dsi-v-bottom-border = <0>;
		qcom,mdss-pan-physical-width-dimension = <62>;
		qcom,mdss-pan-physical-height-dimension = <110>;
		qcom,mdss-dsi-bpp = <24>;
		qcom,mdss-dsi-color-order = "rgb_swap_rgb";
		qcom,mdss-dsi-underflow-color = <0>;
		qcom,mdss-dsi-border-color = <0>;
		qcom,mdss-dsi-post-panel-on-command = [
			05 01 00 00 78 00 02
			11 00
			05 01 00 00 14 00 02
			29 00
		];
		qcom,mdss-dsi-off-command = [
			05 01 00 00 00 00 02
			28 00
			05 01 00 00 78 00 02
			10 00
		];

		lge,comfort-view-cmds-step1 = [ /*Step1 6950K*/
			29 01 00 00 00 00 02 B0 04 // MACP
			15 01 00 00 00 00 02 C8 11
			29 01 00 00 00 00 13 C9 00 00 00 00 00 FC 00 00 00 00 00 AF 00 00 00 00 00 8A
			29 01 00 00 00 00 05 CA 1D FC FC FC
			29 01 00 00 00 00 02 B0 03 // MACP
		];
		lge,comfort-view-cmds-step2 = [ /*Step2 6650*/
			29 01 00 00 00 00 02 B0 04 // MACP
			15 01 00 00 00 00 02 C8 11
			29 01 00 00 00 00 13 C9 00 00 00 00 00 FC 00 00 00 00 00 A8 00 00 00 00 00 75
			29 01 00 00 00 00 05 CA 1D FC FC FC
			29 01 00 00 00 00 02 B0 03 // MACP
		];
		lge,comfort-view-cmds-step3 = [ /*Step3 6300*/
			29 01 00 00 00 00 02 B0 04 // MACP
			15 01 00 00 00 00 02 C8 11
			29 01 00 00 00 00 13 C9 00 00 00 00 00 FC 00 00 00 00 00 A0 00 00 00 00 00 53
			29 01 00 00 00 00 05 CA 1D FC FC FC
			29 01 00 00 00 00 02 B0 03 // MACP
		];
		lge,comfort-view-cmds-step4 = [ /*Step4 6000*/
			29 01 00 00 00 00 02 B0 04 // MACP
			15 01 00 00 00 00 02 C8 11
			29 01 00 00 00 00 13 C9 00 00 00 00 00 FC 00 00 00 00 00 99 00 00 00 00 00 34
			29 01 00 00 00 00 05 CA 1D FC FC FC
			29 01 00 00 00 00 02 B0 03 // MACP
		];
		lge,comfort-view-cmds-step5 = [ /*Step5 5650*/
			29 01 00 00 00 00 02 B0 04 // MACP
			15 01 00 00 00 00 02 C8 11
			29 01 00 00 00 00 13 C9 00 00 00 00 00 FC 00 00 00 00 00 90 00 00 00 00 00 08
			29 01 00 00 00 00 05 CA 1D FC FC FC
			29 01 00 00 00 00 02 B0 03 // MACP

		];
		lge,comfort-view-cmds-step6 = [ /*Step6 5300*/
			29 01 00 00 00 00 02 B0 04 // MACP
			15 01 00 00 00 00 02 C8 11
			29 01 00 00 00 00 13 C9 00 00 00 00 00 FC 00 00 00 00 00 90 00 00 00 00 00 00
			29 01 00 00 00 00 05 CA 1D FC F2 C5
			29 01 00 00 00 00 02 B0 03 // MACP
		];
		lge,comfort-view-cmds-step7 = [ /*Step7 5150*/
			29 01 00 00 00 00 02 B0 04 // MACP
			15 01 00 00 00 00 02 C8 11
			29 01 00 00 00 00 13 C9 00 00 00 00 00 FC 00 00 00 00 00 90 00 00 00 00 00 00
			29 01 00 00 00 00 05 CA 1D FC E8 A7
			29 01 00 00 00 00 02 B0 03 // MACP
		];
		lge,comfort-view-cmds-step8 = [ /*Step8 5000*/
			29 01 00 00 00 00 02 B0 04 // MACP
			15 01 00 00 00 00 02 C8 11
			29 01 00 00 00 00 13 C9 00 00 00 00 00 FC 00 00 00 00 00 90 00 00 00 00 00 00
			29 01 00 00 00 00 05 CA 1D FC DE 88
			29 01 00 00 00 00 02 B0 03 // MACP
		];
		lge,comfort-view-cmds-step9 = [ /*Step9 4800*/
			29 01 00 00 00 00 02 B0 04 // MACP
			15 01 00 00 00 00 02 C8 11
			29 01 00 00 00 00 13 C9 00 00 00 00 00 FC 00 00 00 00 00 90 00 00 00 00 00 00
			29 01 00 00 00 00 05 CA 1D FC D3 5E
			29 01 00 00 00 00 02 B0 03 // MACP
		];
		lge,comfort-view-cmds-step10 = [ /*Step10 4650*/
			29 01 00 00 00 00 02 B0 04 // MACP
			15 01 00 00 00 00 02 C8 11
			29 01 00 00 00 00 13 C9 00 00 00 00 00 FC 00 00 00 00 00 90 00 00 00 00 00 00
			29 01 00 00 00 00 05 CA 1D FC C8 3F
			29 01 00 00 00 00 02 B0 03 // MACP
		];

		lge,comfort-view-cmds-off = [	// NORMAL
			29 01 00 00 00 00 02 B0 04 // MACP
			15 01 00 00 00 00 02 C8 11
			29 01 00 00 00 00 13 C9 00 00 00 00 00 FC 00 00 00 00 00 FC 00 00 00 00 00 FC
			29 01 00 00 00 00 05 CA 1C FC FC FC
			29 01 00 00 00 00 02 B0 03 // MACP
		];

		lge,comfort-view-cmds-state = "dsi_hs_mode";

		qcom,mdss-dsi-on-command-state = "dsi_lp_mode";
		qcom,mdss-dsi-off-command-state = "dsi_hs_mode";
		qcom,mdss-dsi-h-sync-pulse = <1>;
		qcom,mdss-dsi-traffic-mode = "non_burst_sync_pulse";
		qcom,mdss-dsi-lane-map = "lane_map_0123";
		qcom,mdss-dsi-bllp-eof-power-mode;
		qcom,mdss-dsi-bllp-power-mode;
		qcom,mdss-dsi-lane-0-state;
		qcom,mdss-dsi-lane-1-state;
		qcom,mdss-dsi-lane-2-state;
		qcom,mdss-dsi-lane-3-state;
		qcom,mdss-dsi-tx-eot-append;
		qcom,mdss-dsi-panel-timings = [94 20 14 00 46 48 1A 24 18 03 04 00];
		qcom,mdss-dsi-t-clk-post = <0x04>;
		qcom,mdss-dsi-t-clk-pre = <0x1D>;

		//The following feature "none" and "trigger_sw" are the same in video mode.
		//The feature used any option of TE signal in command mode.
		qcom,mdss-dsi-dma-trigger = "trigger_sw";	//default "trigger_sw"
		qcom,mdss-dsi-mdp-trigger = "trigger_sw";	//default "trigger_sw"

		qcom,mdss-dsi-bl-min-level = <1>;
		qcom,mdss-dsi-bl-max-level = <255>;
		qcom,mdss-dsi-bl-pmic-control-type = "bl_ctrl_wled";
		qcom,mdss-dsi-reset-sequence = <0 10>, <1 130>;

		lge,blmap-size = <256>;
		lge,blmap = <   0 35 35 35 35 35 35 35 35 35			/* 0 ~ 9 */
			35 37 39 41 44 46 48 50 53 55				/* 10 ~ 19 */
			57 59 62 64 66 68 71 73 75 77				/* 20 ~ 29 */
			80 82 84 86 89 91 93 96 98 100				/* 30 ~ 39 */
			102 105 107 109 111 114 116 118 120 123			/* 40 ~ 49 */
			125 127 129 132 134 136 138 141 143 145			/* 50 ~ 59 */
			148 155 163 171 179 187 195 203 211 219			/* 60 ~ 69 */
			227 235 243 251 259 267 275 283 291 299			/* 70 ~ 79 */
			307 315 323 331 339 346 354 362 370 378			/* 80 ~ 89 */
			386 394 402 410 418 426 434 442 450 458			/* 90 ~ 99 */
			466 474 482 490 498 506 514 522 530 544			/* 100 ~ 109 */
			559 573 588 602 617 631 646 660 675 690			/* 110 ~ 119 */
			704 719 733 748 762 777 791 806 821 835			/* 120 ~ 129 */
			850 864 879 893 908 922 937 951 966 981			/* 130 ~ 139 */
			995 1010 1024 1039 1053 1068 1082 1097 1112 1126	/* 140 ~ 149 */
			1141 1155 1170 1184 1199 1213 1228 1243 1264 1286	/* 150 ~ 159 */
			1308 1330 1351 1373 1395 1417 1438 1460 1482 1504	/* 160 ~ 169 */
			1525 1547 1569 1591 1612 1634 1656 1678 1699 1721	/* 170 ~ 179 */
			1743 1765 1786 1808 1830 1852 1873 1895 1917 1939	/* 180 ~ 189 */
			1960 1982 2004 2026 2047 2069 2091 2113 2134 2156	/* 190 ~ 199 */
			2178 2200 2221 2243 2265 2287 2309 2338 2367 2397	/* 200 ~ 209 */
			2426 2456 2485 2514 2544 2573 2603 2632 2661 2691	/* 210 ~ 219 */
			2720 2750 2779 2808 2838 2867 2897 2926 2955 2985	/* 220 ~ 229 */
			3014 3044 3073 3103 3132 3161 3191 3220 3250 3279	/* 230 ~ 239 */
			3308 3338 3367 3397 3426 3455 3485 3514 3544 3573	/* 240 ~ 249 */
			3602 3632 3661 3691 3720 3750 >;			/* 250 ~ 255 */
	};
};
